## zephyr/boards/native_posix_64.conf
```kconfig
CONFIG_SDL_DISPLAY_DEV_NAME="DISPLAY"
CONFIG_SDL_DISPLAY_X_RES=240
CONFIG_SDL_DISPLAY_Y_RES=240

CONFIG_KSCAN=y
CONFIG_LVGL_POINTER_KSCAN=y
CONFIG_LVGL_HOR_RES_MAX=240
CONFIG_LVGL_VER_RES_MAX=240
CONFIG_LVGL_DPI=100
CONFIG_LVGL=y
CONFIG_LVGL_USE_LABEL=y
CONFIG_LVGL_USE_CONT=y
CONFIG_LVGL_USE_BTN=y
CONFIG_LVGL_USE_THEME_MATERIAL=y

CONFIG_DISPLAY=y
CONFIG_DISPLAY_LOG_LEVEL_ERR=y

CONFIG_BT=n
CONFIG_FLASH=n
# TODO: Add configuration for flash emulation

CONFIG_HEAP_MEM_POOL_SIZE=32768

# Network config

# General config
CONFIG_NEWLIB_LIBC=y

# Networking config
CONFIG_NETWORKING=y
CONFIG_NET_IPV4=y
CONFIG_NET_IPV6=y
CONFIG_NET_TCP=y
CONFIG_NET_SOCKETS=y
CONFIG_NET_SOCKETS_POSIX_NAMES=y
# CONFIG_NET_SOCKETS_SOCKOPT_TLS=y

CONFIG_DNS_RESOLVER=y
CONFIG_DNS_SERVER_IP_ADDRESSES=y
CONFIG_DNS_SERVER1="8.8.8.8"

# Network driver config
CONFIG_TEST_RANDOM_GENERATOR=y

# Network address config
CONFIG_NET_CONFIG_SETTINGS=y
CONFIG_NET_CONFIG_NEED_IPV4=y
CONFIG_NET_CONFIG_MY_IPV4_ADDR="192.0.2.1"
CONFIG_NET_CONFIG_PEER_IPV4_ADDR="192.0.2.2"
CONFIG_NET_CONFIG_MY_IPV4_GW="192.0.2.2"

# Network debug config
CONFIG_NET_LOG=y

CONFIG_TLS_CREDENTIAL_FILENAMES=y
```
